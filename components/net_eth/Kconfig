## components/net_eth/Kconfig
```kconfig
menu "Net Ethernet Configuration"

config NET_ETH_INIT
    bool "Initialize Ethernet (net_eth)"
    default n
    help
        Enable Ethernet initialization on startup.

endmenu
```

## components/test_pattern_source/Kconfig
```kconfig
menu "Test Pattern Source Configuration"

config TEST_PATTERN_FPS
    int "Test Pattern Frames Per Second"
    default 10
    range 1 60
    help
        Frames per second for the test pattern video source.

endmenu
```

## main/Kconfig.projbuild
```kconfig
menu "Quad IP-KVM Configuration"


    config TC358743_START_CSI
        bool "Initialize TC358743 full CSI startup"
        default n
        depends on TC358743_INIT
        help
            Enables the full HDMI RX PHY, PLL, and CSI sequence after tc358743_init.

    config TC358743_RESET_GPIO
        int "TC358743 reset GPIO"
        default 16
        depends on TC358743_START_CSI
        help
            GPIO used for TC358743 hard reset (active low).
            Defaults to 16 for X630. Set to -1 if not wired.
            TODO(hw-verify): Wiring for GPIO16 is a manual step for the owner,
            and its lack of interference with other schematic items needs verification.

    config TC358743_CSI_CONTINUOUS_CLOCK
        bool "Use continuous clock mode for CSI"
        default n
        depends on TC358743_START_CSI
        help
            If true, sets TXOPTIONCNTRL to continuous clock mode instead of non-continuous.
            TODO(hw-verify): Effect on ESP32-P4 CSI host is unknown.

    choice TC358743_EDID_PROFILE
        prompt "TC358743 advertised EDID profile"
        default TC358743_EDID_720P60
        depends on TC358743_START_CSI
        help
            Select the maximum video mode advertised in TC358743 EDID RAM.
            720p60 is the conservative baseline; 1080p30 adds 1920x1080@30Hz (74.25 MHz,
            within 2-lane 972 Mbps RGB888 bandwidth).

        config TC358743_EDID_720P60
            bool "720p60 max (1280x720@60, 640x480@60)"

        config TC358743_EDID_1080P30
            bool "1080p30 max (1920x1080@30, 1280x720@60, 640x480@60)"
    endchoice

    choice TC358743_CSI_FORMAT
        prompt "TC358743 CSI output pixel format"
        default TC358743_CSI_FORMAT_RGB888
        depends on TC358743_START_CSI
        help
            Select the CSI-2 output format generated by TC358743:
            - RGB888 (0x24, 24 bpp): verified baseline feeding HW JPEG directly (P2b-3..P2b-7).
            - UYVY   (0x1E, 16 bpp): P2b-8 experimental path (PPA SRM 4-byte swap -> HW JPEG YUV422).

        config TC358743_CSI_FORMAT_RGB888
            bool "RGB888 (24 bpp, direct HW JPEG YUV420)"

        config TC358743_CSI_FORMAT_UYVY
            bool "UYVY 4:2:2 (16 bpp, PPA 4B swap -> HW JPEG YUV422)"
    endchoice

    config TC358743_CSI_LANE_RATE_MBPS
        int "TC358743 & ESP32-P4 CSI lane bit rate (Mbps)"
        default 972
        range 445 972
        depends on TC358743_START_CSI
        help
            CSI-2 per-lane bit rate in Mbps (must be 972, 594, or 445 for the 445.5 Mbps P2b-8 mode).
            Both TC358743 PLL/timings and ESP32-P4 CSI D-PHY use this value.
    config TC358743_INIT
        bool "Initialize TC358743 on startup"
        default n
        help
            Enable this to initialize the TC358743 HDMI-CSI bridge during app_main.
            Requires proper I2C connections on the hardware.

    config CSI_CAPTURE_TEST
        bool "Capture RGB888 frames over MIPI CSI after HDMI lock (P2b-4 test)"
        default n
        depends on TC358743_START_CSI && MIPI_PHY_POWER_ENABLE
        help
            After tc358743_start_csi reports HDMI lock, opens csi_capture with the measured active
            size, receives CSI_CAPTURE_TEST_FRAMES frames into PSRAM and logs per-frame statistics,
            then stops the CSI DMA. Hardware bring-up only (verified on rev v1.3 at 1280x720@60fps;
            see docs/HW_VERIFY.md E.1 item 9).

    config CSI_CAPTURE_TEST_FRAMES
        int "Number of frames to capture in the test"
        default 30
        range 1 1000
        depends on CSI_CAPTURE_TEST

    config CSI_CAPTURE_MAX_WIDTH
        int "CSI capture buffer max width (pixels)"
        default 1920
        range 64 1920
        depends on CSI_CAPTURE_TEST || VIDEO_SOURCE_CSI
        help
            Two RGB888 buffers of MAX_WIDTH x MAX_HEIGHT x 3 bytes are allocated once in PSRAM.
            Frames larger than this are rejected before the DMA is configured.

    config CSI_CAPTURE_MAX_HEIGHT
        int "CSI capture buffer max height (lines)"
        default 1080
        range 64 1080
        depends on CSI_CAPTURE_TEST || VIDEO_SOURCE_CSI

    config CSI_CAPTURE_ISP_BYPASS
        bool "Create an ISP processor with bypass_isp (reference configuration)"
        default y
        depends on CSI_CAPTURE_TEST || VIDEO_SOURCE_CSI
        help
            p4kvm / ESP-KVM create a bypassed ISP processor next to the CSI controller
            (docs/P2B_TC358743_REFERENCE.md 4-1). Verified working on rev v1.3 (docs/HW_VERIFY.md E14).

    choice VIDEO_SOURCE_SELECT
        prompt "Video source for Frame Hub"
        default VIDEO_SOURCE_TEST_PATTERN
        help
            Select which video_source_t implementation publishes JPEG frames to Frame Hub.

        config VIDEO_SOURCE_TEST_PATTERN
            bool "Test pattern source (synthetic MJPEG)"

        config VIDEO_SOURCE_CSI
            bool "MIPI CSI HDMI capture + HW JPEG encoder (TC358743)"
            depends on TC358743_START_CSI && MIPI_PHY_POWER_ENABLE && !CSI_CAPTURE_TEST
            help
                Publishes live HDMI frames captured from TC358743 over MIPI CSI-2 and
                compressed by the ESP32-P4 hardware JPEG encoder (YUV420) to Frame Hub.
    endchoice

    config JPEG_ENCODE_QUALITY
        int "Hardware JPEG encoder quality (1-100)"
        default 70
        range 1 100
        depends on VIDEO_SOURCE_CSI
        help
            JPEG compression quality passed to esp_driver_jpeg (YUV420 subsampling).
            Reference default on ESP32-P4 rev v1.3 is 70 (docs/P2B_PLAN.md P2b-5).

    config MIPI_PHY_POWER_ENABLE
        bool "Enable MIPI PHY power"
        default n
        help
            Enable the on-chip LDO (VO3) that powers VDD_MIPI_DPHY.
            If disabled (default), the LDO is not touched.
            Before enabling for the first time, disconnect the CSI cable and measure the
            voltage at VDD_MIPI_DPHY (U6 pin 41) on the board.
            TODO(hw-verify): the voltage for chip rev v1.3 is unverified.

    config MIPI_PHY_LDO_CHAN
        int "MIPI PHY LDO Channel"
        default 3
        range 3 3

    config MIPI_PHY_LDO_MV
        int "MIPI PHY LDO Voltage (mV)"
        default 2500
        range 2250 2750
        help
            Recommended 2250..2750 mV (typ. 2500 mV) from the ESP32-P4 datasheet v0.7.
            The absolute maximum is 2750 mV; values above it are rejected at build and run time.
            TODO(hw-verify): the datasheet is for chip rev v3.x; applicability to rev v1.3 is unverified.


    config FRAME_HUB_POOL_SIZE
        int "Frame Hub pool size"
        default 3
        range 2 32
        help
            Number of frame buffers in the pool.

    config FRAME_HUB_MAX_FRAME_KB
        int "Frame Hub max frame size in KB"
        default 256 if FRAME_HUB_PREFER_SPIRAM
        default 64
        range 1 4096
        help
            PSRAM が有効な既定では 256KB（1080p の MJPEG 1 枚の目安）。PSRAM が無いときは内蔵 RAM に収まる 64KB

    config FRAME_HUB_PREFER_SPIRAM
        bool "Prefer SPIRAM for Frame Hub buffers"
        default y
        depends on SPIRAM
        help
            If enabled, attempts to allocate frame buffers from SPIRAM first.
            Falls back to internal RAM if SPIRAM allocation fails.


    config WEB_SERVER_ENABLE
        bool "Enable HTTPS Web Server"
        default n
        help
            Enable the embedded HTTPS web server for management and KVM view.

    config WEB_SERVER_ALLOWED_HOSTS
        string "Allowed Host Header (comma separated)"
        default "quad-ipkvm.local"

    config WEB_SERVER_PBKDF2_ITERATIONS
        int "PBKDF2 Iterations"
        default 10000
        range 10000 100000
        help
            The number of PBKDF2 iterations to use for the login password.

    config WEB_SERVER_CERT_TASK_STACK_SIZE
        int "Web Server Certificate Generation Task Stack Size"
        default 16384
        range 8192 32768
        help
            Stack size for the temporary task that generates the X.509 certificate.
            Generation via PSA Crypto API requires significant stack space.
    config WEB_SERVER_PBKDF2_TASK_STACK_SIZE
        int "Web Server PBKDF2 Task Stack Size"
        default 8192
        range 4096 32768
        help
            Stack size for the worker task that computes PBKDF2 hashes.
            Needs enough for mbedTLS PBKDF2 context.

    config WEB_SERVER_WS_MAX_CLIENTS
        int "Max simultaneous WS clients"
        default 2
        range 1 8
        help
            Maximum number of simultaneous WebSocket video viewers (WS /video).
            Each client is sent from the single httpd task, so keep this small.

    config WEB_SERVER_WS_TICK_MS
        int "WS Tick interval (ms)"
        default 20
        range 5 200
        help
            Interval at which the ws_video task offers the latest frame to each client.

    config WEB_SERVER_WS_TASK_STACK_SIZE
        int "WS Task Stack Size"
        default 4096
        range 2048 16384
        help
            Stack size in bytes of the ws_video task.
            TODO(hw-verify): confirm the stack high water mark on the device.

    config WEB_SERVER_SEND_WAIT_TIMEOUT
        int "WS Send wait timeout (s)"
        default 2
        range 1 10
        help
            send_wait_timeout of the HTTPS server (default SO_SNDTIMEO for non-video HTTP sockets).
            Video WebSocket sockets override SO_SNDTIMEO via WEB_SERVER_WS_SOCK_SNDTIMEO_MS.

    config WEB_SERVER_WS_SEND_TIMEOUT_MS
        int "WS Video in-flight send stall timeout (ms)"
        default 3000
        range 0 30000
        help
            Maximum duration in milliseconds an async WS /video frame send may remain in flight
            before ws_video_core_tick requests disconnecting the stalled client. Set 0 to disable.

    config WEB_SERVER_WS_SOCK_SNDTIMEO_MS
        int "WS Video socket SO_SNDTIMEO (ms)"
        default 250
        range 50 10000
        help
            Per-socket SO_SNDTIMEO in milliseconds set on /video WebSocket fds after handshake
            (ws_video_post_handshake_cb) so a stalled send fails quickly instead of blocking the
            single httpd task for WEB_SERVER_SEND_WAIT_TIMEOUT seconds.

    config WEB_SERVER_INPUT_MAX_CONNECTIONS
        int "Max simultaneous WS input clients (/ws)"
        default 2
        range 1 4

    config WEB_SERVER_INPUT_TICK_MS
        int "WS input Tick interval (ms)"
        default 10
        range 5 200

    config WEB_SERVER_INPUT_TASK_STACK_SIZE
        int "WS input Task Stack Size"
        default 3072
        range 2048 16384

    config HID_HOLD_TIMEOUT_MS
        int "HID input hold timeout (ms)"
        default 3000
        range 500 10000

    config HID_RATE_PER_SEC
        int "HID token bucket rate per sec"
        default 400
        range 100 2000

    config HID_RATE_BURST
        int "HID token bucket burst size"
        default 100
        range 10 1000

    config USB_DEVICE_ENABLE
        bool "Enable composite USB HID device on OTG_HS (J3)"
        default n
        help
            Enable composite TinyUSB HID device (Boot Keyboard + Absolute Pointer +
            Relative Boot Mouse) on ESP32-P4 OTG_HS (J3 connector).

    config USB_DEVICE_VID
        hex "USB Device Vendor ID (idVendor)"
        default 0x303A
        depends on USB_DEVICE_ENABLE

    config USB_DEVICE_PID
        hex "USB Device Product ID (idProduct)"
        default 0x4004
        depends on USB_DEVICE_ENABLE

    config USB_DEVICE_MANUFACTURER
        string "USB Device Manufacturer String"
        default "Quad-IPKVM"
        depends on USB_DEVICE_ENABLE

    config USB_DEVICE_PRODUCT
        string "USB Device Product String"
        default "Quad-IPKVM Composite HID"
        depends on USB_DEVICE_ENABLE

    config USB_DEVICE_BVALID_OVERRIDE
        bool "Assert DWC2 BVALID override for 3-wire J3 cable without 5V VBUS"
        default y
        depends on USB_DEVICE_ENABLE
        help
            Enable GOTGCTL BVALID/VBVALID software override on OTG_HS after
            tinyusb_driver_install(), because J3 pin 1 (5V) is left unconnected
            in the 3-wire (GND, D-, D+) cable to avoid power backfeed.

    config USB_DEVICE_FORCE_FULL_SPEED
        bool "Force Full-Speed (12 Mbps) on OTG_HS UTMI PHY"
        default n
        depends on USB_DEVICE_ENABLE
        help
            Set DWC2 DCFG.devspd=1 (Full-Speed on HS UTMI PHY) after driver install
            as a fallback if High-Speed enumeration fails due to cable integrity
            or BIOS USB stack quirks.
endmenu
```

## sdkconfig.defaults
```kconfig
# Target ESP32-P4
CONFIG_IDF_TARGET="esp32p4"

# Set minimum revision to rev v1.0 (ESP32-P4 v1.3 falls under this v1.x category)
CONFIG_ESP32P4_SELECTS_REV_LESS_V3=y
CONFIG_ESP32P4_REV_MIN_100=y

CONFIG_ESPTOOLPY_FLASHSIZE_32MB=y

CONFIG_SPIRAM=y
# TODO(hw-verify): 負荷時（映像バッファの連続書き込み、Ethernet、JPEG）の 200MHz の安定性は未確認
CONFIG_ESP_HTTPS_SERVER_ENABLE=y
CONFIG_MBEDTLS_PEM_WRITE_C=y
CONFIG_MBEDTLS_PK_WRITE_C=y
CONFIG_MBEDTLS_X509_CRT_WRITE_C=y
CONFIG_WEB_SERVER_ENABLE=y
CONFIG_MBEDTLS_X509_CREATE_C=y
CONFIG_HTTPD_WS_SUPPORT=y
CONFIG_HTTPD_WS_PRE_HANDSHAKE_CB_SUPPORT=y
CONFIG_HTTPD_WS_POST_HANDSHAKE_CB_SUPPORT=y
CONFIG_HTTPD_QUEUE_WORK_BLOCKING=n
```
