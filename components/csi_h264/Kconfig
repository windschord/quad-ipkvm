## components/iso_api/Kconfig
```kconfig
menu "ISO Virtual Media: HTTP API (P8 / C-12)"

    config ISO_ENABLE
        bool "Enable the ISO virtual media HTTP API (/api/v1/iso*)"
        default n
        depends on SD_ENABLE && SD_WORKER_ENABLE && USB_MSC_ENABLE
        help
            Register /api/v1/iso* (upload, list, mount, eject, delete) on the main HTTPS server
            (docs/WEB_API.md section 8, docs/ISO_MOUNT_DESIGN.md). When disabled, the paths are not
            registered (404).
            Requires microSD, iso_worker, and USB virtual CD-ROM (MSC) enabled so all endpoints and
            chunked PUT uploads are wired end-to-end.

    config ISO_OP_LOCK_WAIT_MS
        int "iso_op_mutex wait limit of an HTTP handler (ms)"
        default 20
        range 1 1000
        depends on ISO_ENABLE
        help
            A mutating request waits at most this long for iso_op_mutex, then answers
            503 {"error":"busy"} with Retry-After: 1 (the single-threaded httpd must not be held by the
            worker's long steps). docs/ISO_MOUNT_DESIGN.md section 4.1.

    config ISO_PUT_RECV_TIMEOUT_S
        int "Receive deadline of one PUT chunk (s)"
        default 2
        range 1 30
        depends on ISO_ENABLE
        help
            One chunk must be received within this time; otherwise nothing is written and the
            connection is closed (the /ws input must not be stalled). Used by the PUT receive loop
            (web_iso_service, docs/ISO_MOUNT_DESIGN.md section 6.1).

endmenu
```

## components/iso_sd/Kconfig
```kconfig
menu "ISO Virtual Media: microSD / FAT32 (P8 / A-13)"

    config SD_ENABLE
        bool "Enable microSD Card (SDMMC Slot 0 + FAT32 + iso_sd seams)"
        default n
        depends on SOC_SDMMC_HOST_SUPPORTED
        select FATFS_USE_FASTSEEK
        help
            Enable the Waveshare ESP32-P4-ETH microSD card driver (SDMMC Slot 0:
            D0..D3=GPIO39..42, CLK=GPIO43, CMD=GPIO44, 51k pull-ups on ESP_LDO_VO4,
            PMOS power switch on GPIO45) and implement iso_blockdev_t / iso_fs_t /
            iso_sd_status_t / iso_clock_t for ISO virtual media.
            Requires FATFS_API_ENCODING_UTF_8=y and non-none FATFS_LFN for UTF-8
            filenames in /iso/import/.

    config SD_MAX_FREQ_KHZ
        int "microSD SDMMC max clock frequency (kHz)"
        default 40000
        range 400 40000
        depends on SD_ENABLE
        help
            Maximum SDMMC clock in kHz (40000 = 40 MHz High-Speed, 20000 = 20 MHz
            Default Speed). Hardware verification: docs/HW_VERIFY.md I3.

    config SD_MONITOR_POLL_MS
        int "microSD health/removal monitor polling period (ms)"
        default 2000
        range 500 10000
        depends on SD_ENABLE
        help
            Interval between SD card status checks and card-insertion re-probes
            (there is no hardware card-detect GPIO wired on this board).

    config SD_SELF_TEST_ON_BOOT
        bool "Run non-destructive FAT32/CLMT/raw-sector self-test on boot"
        default n
        depends on SD_ENABLE
        help
            Developer verification only: writes a temporary /iso/_selftest.tmp file,
            verifies iso_fs_t.get_extents() + iso_blockdev_t.read_sectors() match
            iso_fs_t.read(), logs timing and throughput, and removes the temp file.
            Never formats the card. Keep disabled in normal builds.

endmenu
```

## components/iso_usb_msc/Kconfig
```kconfig
menu "Quad-IPKVM USB Virtual CD-ROM (MSC)"

    config USB_MSC_ENABLE
        bool "Enable USB Mass Storage (Virtual CD-ROM) interface"
        depends on USB_DEVICE_ENABLE
        default n
        help
            Expose USB interface 3 as a Mass Storage Bulk-Only Transport (BOT)
            virtual CD-ROM using a custom TinyUSB class driver via
            usbd_app_driver_get_cb(). Requires CONFIG_TINYUSB_MSC_ENABLED=n.

    config USB_MSC_BUF_BLOCKS
        int "Double-buffer chunk size in 2048-byte CD blocks"
        depends on USB_MSC_ENABLE
        range 1 16
        default 4
        help
            Number of 2048-byte CD blocks per ping-pong DMA transfer buffer
            (2 buffers total; default 4 blocks = 8 KiB x 2 = 16 KiB).

    config USB_MSC_TASK_STACK_SIZE
        int "iso_msc_task stack size (bytes)"
        depends on USB_MSC_ENABLE
        range 2048 16384
        default 4096

    config USB_MSC_TASK_PRIO
        int "iso_msc_task FreeRTOS priority"
        depends on USB_MSC_ENABLE
        range 1 10
        default 4

endmenu
```

## components/iso_worker/Kconfig
```kconfig
menu "ISO Virtual Media: Background Worker (P8 / A-13)"

    config SD_WORKER_ENABLE
        bool "Enable ISO background worker task (iso_worker)"
        default n
        depends on SD_ENABLE
        help
            Enable the FreeRTOS background worker task that serializes
            iso_core / iso_upload / iso_catalog jobs (FINISH, INDEX, DELETE,
            IDLE_CLOSE), drives idle timeouts via iso_upload_tick(), and
            coordinates managed microSD fault/reprobe recovery per
            docs/ISO_MOUNT_DESIGN.md sections 3.4 and 4.2.

    config SD_WORKER_TASK_STACK_SIZE
        int "iso_worker task stack size (bytes)"
        default 8192
        range 4096 16384
        depends on SD_WORKER_ENABLE
        help
            TODO(hw-verify): measure FreeRTOS stack high-water mark (HW_VERIFY I10).

    config SD_WORKER_TASK_PRIO
        int "iso_worker FreeRTOS task priority"
        default 3
        range 1 10
        depends on SD_WORKER_ENABLE

    config SD_WORKER_BUDGET_KIB
        int "iso_worker step budget (KiB)"
        default 1024
        range 64 4096
        depends on SD_WORKER_ENABLE
        help
            Maximum read/re-hash budget per iso_job_step() before yielding
            iso_op_mutex so HTTP requests can preempt or proceed.

    config SD_WORKER_IO_BUF_KB
        int "iso_worker SHA-256 re-hash read buffer size (KiB)"
        default 32
        range 4 128
        depends on SD_WORKER_ENABLE

    config SD_WORKER_DELETE_POLL_MS
        int "iso_worker poll delay while DELETE waits for MSC refs (ms)"
        default 50
        range 10 500
        depends on SD_WORKER_ENABLE

endmenu
```

## components/kvm_board/Kconfig
```kconfig
menu "KVM Board (74HC139 / ATX / KVM LED) Configuration"

    config KVM_BOARD_ENABLE
        bool "Enable KVM/ATX real GPIO board driver and start kvm_service"
        default n
        depends on SOC_GPTIMER_SUPPORTED
        select GPTIMER_ISR_CACHE_SAFE
        select GPTIMER_CTRL_FUNC_IN_IRAM
        help
            Enable the real GPIO + GPTimer board HAL in components/kvm_board and start
            kvm_service on boot. Keep disabled until the 74HC139 decoders, photorelays,
            pull-ups/pull-downs, and KVM LED sense lines are wired and verified.
            Automatically selects GPTIMER_ISR_CACHE_SAFE and GPTIMER_CTRL_FUNC_IN_IRAM
            so the auto-release timer ISR keeps running while flash cache is disabled
            (e.g., NVS writes / OTA).
            TODO(hw-verify)

    config KVM_BOARD_GPIO_A0
        int "74HC139 A0 address GPIO (-1 = unassigned)"
        default -1
        range -1 54
        depends on KVM_BOARD_ENABLE
        help
            GPIO driving 74HC139 A0 (expects external 100k pull-down -> GND so reset state is CH1).
            TODO(hw-verify)

    config KVM_BOARD_GPIO_A1
        int "74HC139 A1 address GPIO (-1 = unassigned)"
        default -1
        range -1 54
        depends on KVM_BOARD_ENABLE
        help
            GPIO driving 74HC139 A1 (expects external 100k pull-down -> GND so reset state is CH1).
            TODO(hw-verify)

    config KVM_BOARD_GPIO_E_POWER
        int "74HC139#1 E_PWR active-low enable GPIO (-1 = unassigned)"
        default -1
        range -1 54
        depends on KVM_BOARD_ENABLE
        help
            Active-low enable for ATX POWER / POWER_FORCE (expects external 10k pull-up -> 3V3).
            TODO(hw-verify)

    config KVM_BOARD_GPIO_E_RESET
        int "74HC139#1 E_RST active-low enable GPIO (-1 = unassigned)"
        default -1
        range -1 54
        depends on KVM_BOARD_ENABLE
        help
            Active-low enable for ATX RESET (expects external 10k pull-up -> 3V3).
            TODO(hw-verify)

    config KVM_BOARD_GPIO_E_KVM
        int "74HC139#2 E_KVM active-low enable GPIO (-1 = unassigned)"
        default -1
        range -1 54
        depends on KVM_BOARD_ENABLE
        help
            Active-low enable for KVM switch button optocoupler (expects external 10k pull-up -> 3V3).
            TODO(hw-verify)

    config KVM_BOARD_GPIO_LED_CH1
        int "KVM LED sense CH1 GPIO (-1 = unassigned)"
        default -1
        range -1 54
        depends on KVM_BOARD_ENABLE
        help
            GPIO reading KVM channel 1 LED state.
            Internal pull-up and pull-down are DISABLED; external photocoupler / open-collector
            circuit MUST provide an external pull-up (or pull-down) resistor so the input does not float.
            TODO(hw-verify)

    config KVM_BOARD_GPIO_LED_CH2
        int "KVM LED sense CH2 GPIO (-1 = unassigned)"
        default -1
        range -1 54
        depends on KVM_BOARD_ENABLE
        help
            GPIO reading KVM channel 2 LED state.
            Internal pull-up and pull-down are DISABLED; external photocoupler / open-collector
            circuit MUST provide an external pull-up (or pull-down) resistor so the input does not float.
            TODO(hw-verify)

    config KVM_BOARD_GPIO_LED_CH3
        int "KVM LED sense CH3 GPIO (-1 = unassigned)"
        default -1
        range -1 54
        depends on KVM_BOARD_ENABLE
        help
            GPIO reading KVM channel 3 LED state.
            Internal pull-up and pull-down are DISABLED; external photocoupler / open-collector
            circuit MUST provide an external pull-up (or pull-down) resistor so the input does not float.
            TODO(hw-verify)

    config KVM_BOARD_GPIO_LED_CH4
        int "KVM LED sense CH4 GPIO (-1 = unassigned)"
        default -1
        range -1 54
        depends on KVM_BOARD_ENABLE
        help
            GPIO reading KVM channel 4 LED state.
            Internal pull-up and pull-down are DISABLED; external photocoupler / open-collector
            circuit MUST provide an external pull-up (or pull-down) resistor so the input does not float.
            TODO(hw-verify)

    choice KVM_BOARD_LED_POLARITY
        prompt "KVM LED sense polarity"
        default KVM_BOARD_LED_POLARITY_UNSET
        depends on KVM_BOARD_ENABLE
        help
            Wait for docs/HW_VERIFY.md A6 measurement on the KVM PCB before selecting
            ACTIVE_LOW or ACTIVE_HIGH. Leaving this UNSET fails runtime init closed
            while keeping CI Kconfig builds non-interactive.
            TODO(hw-verify)

        config KVM_BOARD_LED_POLARITY_UNSET
            bool "Unset (fail-closed until HW_VERIFY A6 is measured)"

        config KVM_BOARD_LED_POLARITY_ACTIVE_LOW
            bool "Active-low (0 = lit)"

        config KVM_BOARD_LED_POLARITY_ACTIVE_HIGH
            bool "Active-high (1 = lit)"
    endchoice

    config KVM_BOARD_ALLOW_JTAG_INPUTS
        bool "Allow JTAG GPIOs (GPIO2..5) for KVM LED inputs only"
        default n
        depends on KVM_BOARD_ENABLE
        help
            Leave disabled unless P1 pin budget requires reusing JTAG pins as LED inputs.
            JTAG pins are always rejected for 74HC139 outputs (A0/A1/E_*).
            TODO(hw-verify)

    config KVM_BOARD_HARD_MAX_POWER_MS
        int "Hardware timer hard cap for ATX POWER press (ms)"
        default 500
        range 1 500
        depends on KVM_BOARD_ENABLE
        help
            Board-level GPTimer upper bound for POWER short press (capped at KVM_ATX_HARD_MAX_POWER_MS=500).
            TODO(hw-verify)

    config KVM_BOARD_HARD_MAX_RESET_MS
        int "Hardware timer hard cap for ATX RESET press (ms)"
        default 200
        range 1 200
        depends on KVM_BOARD_ENABLE
        help
            Board-level GPTimer upper bound for RESET press (capped at KVM_ATX_HARD_MAX_RESET_MS=200).
            TODO(hw-verify)

    config KVM_BOARD_HARD_MAX_FORCE_MS
        int "Hardware timer hard cap for ATX POWER force-off hold (ms)"
        default 5000
        range 1 5000
        depends on KVM_BOARD_ENABLE
        help
            Board-level GPTimer upper bound for FORCE hold (capped at KVM_ATX_HARD_MAX_FORCE_MS=5000).
            TODO(hw-verify)

    config KVM_BOARD_HARD_MAX_KVM_MS
        int "Hardware timer hard cap for KVM switch pulse (ms)"
        default 1000
        range 1 5000
        depends on KVM_BOARD_ENABLE
        help
            Board-level GPTimer upper bound for KVM switch optocoupler pulse (default KVM_BOARD_DEFAULT_HARD_MAX_KVM_MS=1000, cap=5000).
            TODO(hw-verify)

endmenu
```

## sdkconfig.defaults
```kconfig
# Target ESP32-P4
CONFIG_IDF_TARGET="esp32p4"

# Set minimum revision to rev v1.0 (ESP32-P4 v1.3 falls under this v1.x category)
CONFIG_ESP32P4_SELECTS_REV_LESS_V3=y
CONFIG_ESP32P4_REV_MIN_100=y

CONFIG_ESPTOOLPY_FLASHSIZE_32MB=y

CONFIG_SPIRAM=y
# TODO(hw-verify): 負荷時（映像バッファの連続書き込み、Ethernet、JPEG）の 200MHz の安定性は未確認
CONFIG_ESP_HTTPS_SERVER_ENABLE=y
CONFIG_MBEDTLS_PEM_WRITE_C=y
CONFIG_MBEDTLS_PK_WRITE_C=y
CONFIG_MBEDTLS_X509_CRT_WRITE_C=y
CONFIG_WEB_SERVER_ENABLE=y
CONFIG_MBEDTLS_X509_CREATE_C=y
CONFIG_HTTPD_WS_SUPPORT=y
CONFIG_HTTPD_WS_PRE_HANDSHAKE_CB_SUPPORT=y
CONFIG_HTTPD_WS_POST_HANDSHAKE_CB_SUPPORT=y
CONFIG_HTTPD_QUEUE_WORK_BLOCKING=n
CONFIG_LWIP_MAX_SOCKETS=24
CONFIG_ETH_DMA_BUFFER_SIZE=1536
CONFIG_ETH_DMA_RX_BUFFER_NUM=20
CONFIG_ETH_DMA_TX_BUFFER_NUM=20
CONFIG_LWIP_TCP_SND_BUF_DEFAULT=32768
CONFIG_LWIP_TCP_WND_DEFAULT=32768
CONFIG_LWIP_TCP_RECVMBOX_SIZE=24
CONFIG_LWIP_TCP_TMR_INTERVAL=100
CONFIG_LWIP_TCP_RTO_TIME=600
CONFIG_TINYUSB_HID_COUNT=3
CONFIG_FATFS_LFN_HEAP=y
CONFIG_FATFS_API_ENCODING_UTF_8=y
CONFIG_FATFS_USE_FASTSEEK=y
```
